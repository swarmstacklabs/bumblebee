## br2-external/Config.in
```kconfig
menu "Bumblebee RPi external options"
endmenu

source "$BR2_EXTERNAL_BUMBLEBEE_RPI_PATH/package/skeleton-app/Config.in"
source "$BR2_EXTERNAL_BUMBLEBEE_RPI_PATH/package/lorawan-server/Config.in"
source "$BR2_EXTERNAL_BUMBLEBEE_RPI_PATH/package/wifi-inspect/Config.in"
```

## br2-external/package/custom-app/Config.in
```kconfig
config BR2_PACKAGE_CUSTOM_APP
	bool "custom-app"
	help
	  Project application template. Replace with your real service or agent.
```

## br2-external/package/lorawan-server-ui/Config.in
```kconfig
config BR2_PACKAGE_LORAWAN_SERVER_UI
	bool "lorawan-server-ui"
	help
	  Install the built Vue admin UI for lorawan-server into
	  /usr/share/lorawan-server/frontend.
```

## br2-external/package/lorawan-server/Config.in
```kconfig
config BR2_PACKAGE_LORAWAN_SERVER
	bool "lorawan-server"
	select BR2_PACKAGE_SQLITE
	select BR2_PACKAGE_LORAWAN_SERVER_UI
	help
	  Build and install the LoRaWAN UDP bridge plus HTTP CRUD API.
```

## br2-external/package/skeleton-app/Config.in
```kconfig
config BR2_PACKAGE_SKELETON_APP
	bool "skeleton-app"
	help
	  Dummy package placeholder for future project software.
```

## br2-external/package/wifi-inspect/Config.in
```kconfig
config BR2_PACKAGE_WIFI_INSPECT
	bool "wifi-inspect"
	help
	  Install a Wi-Fi inspection utility with structured logging for
	  embedded diagnostics on Raspberry Pi targets.
```

## configs/rpi3_defconfig
```kconfig
BR2_TARGET_GENERIC_HOSTNAME="bumblebee-rpi3"
BR2_TARGET_GENERIC_ISSUE="Buildroot Raspberry Pi 3 project skeleton v2"
BR2_ROOTFS_OVERLAY="$(BR2_EXTERNAL_BUMBLEBEE_RPI_PATH)/board/common/rootfs-overlay $(BR2_EXTERNAL_BUMBLEBEE_RPI_PATH)/board/rpi3/rootfs-overlay"
BR2_ROOTFS_POST_BUILD_SCRIPT="$(BR2_EXTERNAL_BUMBLEBEE_RPI_PATH)/board/common/post-build.sh"
BR2_ROOTFS_POST_IMAGE_SCRIPT="board/raspberrypi/post-image.sh"
BR2_SYSTEM_DHCP="eth0"
BR2_PACKAGE_DROPBEAR=y
BR2_PACKAGE_DROPBEAR_DISABLE_REVERSEDNS=y
BR2_PACKAGE_IW=y
BR2_PACKAGE_WPA_SUPPLICANT=y
BR2_PACKAGE_WPA_SUPPLICANT_NL80211=y
BR2_PACKAGE_LINUX_FIRMWARE=y
BR2_PACKAGE_LINUX_FIRMWARE_BRCM_BCM43XXX=y
BR2_PACKAGE_RPI_FIRMWARE_CONFIG_FILE="board/raspberrypi/config_3_64bit.txt"
BR2_PACKAGE_CUSTOM_APP=y
BR2_PACKAGE_WIFI_INSPECT=y
```

## configs/rpi4_defconfig
```kconfig
BR2_TARGET_GENERIC_HOSTNAME="bumblebee-rpi4"
BR2_TARGET_GENERIC_ISSUE="Buildroot Raspberry Pi 4 project skeleton v2"
BR2_ROOTFS_OVERLAY="$(BR2_EXTERNAL_BUMBLEBEE_RPI_PATH)/board/common/rootfs-overlay $(BR2_EXTERNAL_BUMBLEBEE_RPI_PATH)/board/rpi4/rootfs-overlay"
BR2_ROOTFS_POST_BUILD_SCRIPT="$(BR2_EXTERNAL_BUMBLEBEE_RPI_PATH)/board/common/post-build.sh"
BR2_ROOTFS_POST_IMAGE_SCRIPT="board/raspberrypi/post-image.sh"
BR2_SYSTEM_DHCP="eth0"
BR2_PACKAGE_DROPBEAR=y
BR2_PACKAGE_DROPBEAR_DISABLE_REVERSEDNS=y
BR2_PACKAGE_IW=y
BR2_PACKAGE_WPA_SUPPLICANT=y
BR2_PACKAGE_WPA_SUPPLICANT_NL80211=y
BR2_PACKAGE_LINUX_FIRMWARE=y
BR2_PACKAGE_LINUX_FIRMWARE_BRCM_BCM43XXX=y
BR2_PACKAGE_RPI_FIRMWARE_CONFIG_FILE="$(BR2_EXTERNAL_BUMBLEBEE_RPI_PATH)/board/rpi4/config_4_64bit.txt"
BR2_PACKAGE_LORAWAN_SERVER=y
BR2_PACKAGE_WIFI_INSPECT=y
```

## configs/rpi5_defconfig
```kconfig
BR2_TARGET_GENERIC_HOSTNAME="bumblebee-rpi5"
BR2_TARGET_GENERIC_ISSUE="Buildroot Raspberry Pi 5 project skeleton v2"
BR2_ROOTFS_OVERLAY="$(BR2_EXTERNAL_BUMBLEBEE_RPI_PATH)/board/common/rootfs-overlay $(BR2_EXTERNAL_BUMBLEBEE_RPI_PATH)/board/rpi5/rootfs-overlay"
BR2_ROOTFS_POST_BUILD_SCRIPT="$(BR2_EXTERNAL_BUMBLEBEE_RPI_PATH)/board/common/post-build.sh"
BR2_ROOTFS_POST_IMAGE_SCRIPT="board/raspberrypi/post-image.sh"
BR2_SYSTEM_DHCP="eth0"
BR2_PACKAGE_DROPBEAR=y
BR2_PACKAGE_DROPBEAR_DISABLE_REVERSEDNS=y
BR2_PACKAGE_IW=y
BR2_PACKAGE_WPA_SUPPLICANT=y
BR2_PACKAGE_WPA_SUPPLICANT_NL80211=y
BR2_PACKAGE_LINUX_FIRMWARE=y
BR2_PACKAGE_LINUX_FIRMWARE_BRCM_BCM43XXX=y
BR2_PACKAGE_RPI_FIRMWARE_CONFIG_FILE="board/raspberrypi/config_5.txt"
BR2_PACKAGE_RPI_FIRMWARE_CMDLINE_FILE="board/raspberrypi/cmdline_5.txt"
BR2_PACKAGE_LORAWAN_SERVER=y
BR2_PACKAGE_WIFI_INSPECT=y
```
